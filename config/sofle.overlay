#include <zephyr/dt-bindings/gpio/gpio.h>

/* Substitui apenas a leitura das linhas para o novo pino */
&kscan0 {
    row-gpios
        = <&pro_micro 4 (GPIO_ACTIVE_HIGH | GPIO_PULL_DOWN)>  /* Row 0 */
        , <&gpio1 1 (GPIO_ACTIVE_HIGH | GPIO_PULL_DOWN)>      /* Row 1: NOSSA PONTE NO PINO 101 */
        , <&pro_micro 6 (GPIO_ACTIVE_HIGH | GPIO_PULL_DOWN)>  /* Row 2 */
        , <&pro_micro 7 (GPIO_ACTIVE_HIGH | GPIO_PULL_DOWN)>  /* Row 3 */
        , <&pro_micro 8 (GPIO_ACTIVE_HIGH | GPIO_PULL_DOWN)>  /* Row 4 */
        ;
};
